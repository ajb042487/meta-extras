## conf/layer.conf
```bitbake
# We have a conf and classes directory, add to BBPATH
BBPATH .= ":${LAYERDIR}"

# We have a packages directory, add to BBFILES
BBFILES += "${LAYERDIR}/recipes*/*/*.bb"

BBFILE_COLLECTIONS += "extras"
BBFILE_PATTERN_extras = "^${LAYERDIR}/"
BBFILE_PRIORITY_extras = "5"

require conf/distro/include/poky-extras-src-revisions.inc
```
